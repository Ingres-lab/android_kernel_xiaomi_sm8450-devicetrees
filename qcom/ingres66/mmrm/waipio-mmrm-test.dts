/dts-v1/;
/plugin/;

#include <dt-bindings/clock/qcom,sm8450-camcc.h>
#include <dt-bindings/clock/qcom,sm8450-videocc.h>
#include <dt-bindings/clock/qcom,sm8450-dispcc.h>
#include "waipio-mmrm-test.dtsi"

/ {
	model = "Qualcomm Technologies, Inc. waipio v1 & v2 SoC";
	compatible = "qcom,waipio";
	qcom,msm-id = <457 0x10000>, <482 0x10000>, <552 0x10000>;
	qcom,board-id = <0 0>; /* required by merge_dtbs.py */
};
