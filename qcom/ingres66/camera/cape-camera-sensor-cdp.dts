/dts-v1/;
/plugin/;

#include <dt-bindings/clock/qcom,gcc-sm8450.h>
#include <dt-bindings/clock/qcom,sm8450-camcc.h>
#include <dt-bindings/interconnect/qcom,waipio.h>
#include <dt-bindings/interrupt-controller/arm-gic.h>
#include <dt-bindings/regulator/qcom,rpmh-regulator-levels.h>

#include "cape-camera-sensor-cdp.dtsi"
/ {
	model = "Qualcomm Technologies, Inc. Cape CDP";
	compatible = "qcom,cape", "qcom,capep";
	qcom,msm-id = <530 0x10000>, <531 0x10000>, <540 0x10000>;
	qcom,board-id = <1 0>, <0x10001 0>, <0x10001 2>;
};
