/dts-v1/;
/plugin/;

#include <dt-bindings/clock/qcom,gcc-sm8450.h>
#include <dt-bindings/clock/qcom,sm8450-camcc.h>
#include <dt-bindings/interconnect/qcom,waipio.h>
#include <dt-bindings/interrupt-controller/arm-gic.h>
#include <dt-bindings/regulator/qcom,rpmh-regulator-levels.h>

#include "cape-camera-sensor-mtp.dtsi"
/ {
	model = "Qualcomm Technologies, Inc. Cape MTP";
	compatible = "qcom,cape", "qcom,capep";
	qcom,msm-id = <530 0x10000>, <531 0x10000>, <540 0x10000>;
	qcom,board-id = <8 0>, <0x10008 0>, <0x10008 2>, <0x10008 3>;
	xiaomi,miboard-id = <0x1000 0>;
};
