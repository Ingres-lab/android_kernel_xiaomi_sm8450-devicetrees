/dts-v1/;
/plugin/;

#include <dt-bindings/interrupt-controller/arm-gic.h>
#include <dt-bindings/soc/qcom,ipcc.h>
#include <dt-bindings/interconnect/qcom,waipio.h>
#include <dt-bindings/clock/qcom,sm8450-videocc.h>
#include <dt-bindings/clock/qcom,gcc-sm8450.h>
#include "waipio-eva.dtsi"

/ {
	model = "Qualcomm Technologies, Inc. cape v1 SoC";
	compatible = "qcom,cape", "qcom,cape-v2";
	qcom,msm-id = <530 0x10000>, <531 0x10000>, <540 0x10000>;
	qcom,board-id = <0 0>;
};
