/dts-v1/;
/plugin/;

#include <dt-bindings/interrupt-controller/arm-gic.h>
#include <dt-bindings/soc/qcom,ipcc.h>
#include <dt-bindings/interconnect/qcom,waipio.h>
#include <dt-bindings/clock/qcom,sm8450-videocc.h>
#include <dt-bindings/clock/qcom,gcc-sm8450.h>
#include "ukee-eva.dtsi"

/ {
	model = "Qualcomm Technologies, Inc. ukee v1 SoC";
	compatible = "qcom,ukee";
	qcom,msm-id = <591 0x10000>;
	qcom,board-id = <0 0>;
};
